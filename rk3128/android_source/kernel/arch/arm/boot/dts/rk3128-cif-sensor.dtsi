#include "../../mach-rockchip/rk_camera_sensor_info.h"
/{
	rk3128_cif_sensor: rk3128_cif_sensor{
			compatible = "rockchip,sensor";
			status = "disabled";
			CONFIG_SENSOR_POWER_IOCTL_USR 		= <1>;
			CONFIG_SENSOR_RESET_IOCTL_USR 		= <0>;
			CONFIG_SENSOR_POWERDOWN_IOCTL_USR	= <0>;
			CONFIG_SENSOR_FLASH_IOCTL_USR	  	= <0>;
			CONFIG_SENSOR_AF_IOCTL_USR	   		= <0>;

     gc2155{
            is_front = <1>;
            rockchip,power = <&gpio3 GPIO_D7 GPIO_ACTIVE_HIGH>;
            rockchip,powerdown = <&gpio3 GPIO_B3 GPIO_ACTIVE_HIGH>;
            pwdn_active = <gc2155_PWRDN_ACTIVE>;
            pwr_active = <PWR_ACTIVE_HIGH>;
            mir = <0>;
            flash_attach = <0>;
            resolution = <gc2155_FULL_RESOLUTION>;
            powerup_sequence = <gc2155_PWRSEQ>;
            orientation = <0>;
            i2c_add = <gc2155_I2C_ADDR>;
            i2c_rata = <100000>;
            i2c_chl = <2>;
            cif_chl = <0>;
            mclk_rate = <24>;
        };
	};
};

